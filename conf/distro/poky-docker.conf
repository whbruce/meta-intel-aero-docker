## conf/distro/poky-docker.conf
```bitbake
require conf/distro/poky.conf
DISTRO = "poky-docker"
DISTRO_NAME = "Poky (with systemd and docker)"

# Docker needs aufs
DISTRO_FEATURES += "aufs"

# Docker happier with systemd
DISTRO_FEATURES_append = " systemd"
VIRTUAL-RUNTIME_init_manager = "systemd"
DISTRO_FEATURES_BACKFILL_CONSIDERED = "sysvinit"
VIRTUAL-RUNTIME_initscripts = "systemd-compat-units"
```

## conf/layer.conf
```bitbake
# We have a conf and classes directory, add to BBPATH
BBPATH .= ":${LAYERDIR}"

# We have recipes-* directories, add to BBFILES
BBFILES += "${LAYERDIR}/recipes-*/*/*.bb \
            ${LAYERDIR}/recipes-*/*/*.bbappend"

BBFILE_COLLECTIONS += "intel-aero-docker"
BBFILE_PATTERN_intel-aero-docker = "^${LAYERDIR}/"
BBFILE_PRIORITY_intel-aero-docker = "6"
LAYERVERSION_intel-aero-docker = "0"
```
